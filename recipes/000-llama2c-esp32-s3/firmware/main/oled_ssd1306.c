/*
 * oled_ssd1306.c — minimal SSD1306 128x64 text display over I2C (ESP-IDF 5.x)
 *
 * MIT — 2026 Emmanuel Vazquez (@Vazquezelectronics) — MicroCortex. Font: classic public-domain 5x7.
 * Non-ASCII input (e.g. accented Spanish) is rendered as '?' in v1.
 */
#include "oled_ssd1306.h"

#include <string.h>

#include "esp_log.h"
#include "esp_check.h"
#include "driver/i2c_master.h"

static const char *TAG = "oled";

/* classic 5x7 font, ASCII 0x20..0x7E, column-major */
static const uint8_t FONT5X7[95][5] = {
    {0x00, 0x00, 0x00, 0x00, 0x00}, {0x00, 0x00, 0x5F, 0x00, 0x00},
    {0x00, 0x07, 0x00, 0x07, 0x00}, {0x14, 0x7F, 0x14, 0x7F, 0x14},
    {0x24, 0x2A, 0x7F, 0x2A, 0x12}, {0x23, 0x13, 0x08, 0x64, 0x62},
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    {0x08, 0x04, 0x08, 0x10, 0x10},
};

static i2c_master_dev_handle_t s_dev = NULL;
static uint8_t s_fb[OLED_W * OLED_H / 8]; /* 1024 bytes, horizontal addressing */

static esp_err_t oled_cmd(uint8_t cmd)
{
    uint8_t buf[2] = {0x00, cmd};
    return i2c_master_transmit(s_dev, buf, 2, -1);
}

static esp_err_t oled_write_fb(void)
{
    uint8_t buf[1 + sizeof(s_fb)];
    buf[0] = 0x40;
    memcpy(buf + 1, s_fb, sizeof(s_fb));
    return i2c_master_transmit(s_dev, buf, sizeof(buf), -1);
}

int oled_init(int sda_gpio, int scl_gpio, uint8_t i2c_addr)
{
    i2c_master_bus_config_t bus_cfg = {
        .i2c_port = 0,
        .sda_io_num = sda_gpio,
        .scl_io_num = scl_gpio,
        .clk_source = I2C_CLK_SRC_DEFAULT,
        .glitch_ignore_cnt = 7,
        .flags.enable_internal_pullup = true,
    };
    i2c_master_bus_handle_t bus = NULL;
    ESP_RETURN_ON_ERROR(i2c_new_master_bus(&bus_cfg, &bus), TAG, "bus init failed");

    i2c_device_config_t dev_cfg = {
        .dev_addr_length = I2C_ADDR_BIT_LEN_7,
        .device_address = i2c_addr,
        .scl_speed_hz = 400000,
    };
    ESP_RETURN_ON_ERROR(i2c_master_bus_add_device(bus, &dev_cfg, &s_dev), TAG, "dev add failed");

    const uint8_t init_seq[] = {
        0xAE, /* display off */
        0xD5, 0x80, /* clock div */
        0xA8, 0x3F, /* multiplexer 1/64 */
        0xD3, 0x00, /* display offset */
        0x40, /* start line 0 */
        0x8D, 0x14, /* charge pump on */
        0x20, 0x00, /* horizontal addressing */
        0xA1, /* segment remap */
        0xC8, /* COM scan dec */
        0xDA, 0x12, /* COM pins */
        0x81, 0xCF, /* contrast */
        0xD9, 0xF1, /* precharge */
        0xDB, 0x40, /* VCOM detect */
        0xA4, /* display from RAM */
        0xA6, /* normal (non-inverted) */
        0xAF, /* display on */
    };
    for (size_t i = 0; i < sizeof(init_seq); i++)
        ESP_RETURN_ON_ERROR(oled_cmd(init_seq[i]), TAG, "init cmd 0x%02X failed", init_seq[i]);

    memset(s_fb, 0, sizeof(s_fb));
    ESP_RETURN_ON_ERROR(oled_write_fb(), TAG, "first flush failed");
    ESP_LOGI(TAG, "SSD1306 ready at 0x%02X (sda=%d scl=%d)", i2c_addr, sda_gpio, scl_gpio);
    return 0;
}

void oled_clear(void)
{
    memset(s_fb, 0, sizeof(s_fb));
}

static void draw_char(int col_px, int page, char c)
{
    if (col_px + 5 > OLED_W || page < 0 || page >= OLED_ROWS) return;
    const uint8_t idx = (c >= 0x20 && c <= 0x7E) ? (uint8_t)(c - 0x20) : ('?' - 0x20);
    for (int i = 0; i < 5; i++) {
        const uint8_t bits = FONT5X7[idx][i];
        s_fb[(size_t)page * OLED_W + col_px + i] = bits;
    }
}

void oled_text(int row, const char *text)
{
    if (row < 0 || row >= OLED_ROWS) return;
    const int start = row * OLED_W;
    memset(s_fb + start, 0, OLED_W); /* clear the line */
    for (int i = 0; i < OLED_COLS && text[i]; i++)
        draw_char(i * 6, row, text[i]);
}

void oled_flush(void)
{
    oled_write_fb();
}
