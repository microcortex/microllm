## recipes/000-llama2c-esp32-s3/firmware/main/Kconfig.projbuild
```kconfig
menu "Johnny runtime (MicroCortex recipe 000)"

    config JOHNNY_MODEL_PARTITION
        string "Partition label holding the .jny model"
        default "model"

    config JOHNNY_PROMPT
        string "Prompt used for generation"
        default "Once upon a time "

    config JOHNNY_MAX_NEW_TOKENS
        int "Max new tokens to generate"
        default 96

    config JOHNNY_TEMPERATURE
        int "Sampling temperature (x100; 80 = 0.80)"
        default 80

    config JOHNNY_USE_OLED
        bool "Stream tokens to a 128x64 SSD1306 OLED over I2C"
        default y

    config JOHNNY_OLED_SDA
        int "OLED SDA GPIO"
        default 8

    config JOHNNY_OLED_SCL
        int "OLED SCL GPIO"
        default 9

    config JOHNNY_OLED_ADDR
        hex "OLED I2C address"
        default 0x3C

endmenu
```
